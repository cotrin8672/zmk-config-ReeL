## boards/raytac/raytac_mdbt50q_cx_40/Kconfig.raytac_mdbt50q_cx_40
```kconfig
config BOARD_RAYTAC_MDBT50Q_CX_40
    select SOC_NRF52840_QIAA
    select ZMK_BOARD_COMPAT
```

## config/west.yml
```yaml
manifest:
  projects:
    - name: zmk
      url: https://github.com/zmkfirmware/zmk
      revision: 4de313367288aad5aeaa1243890e40dc813f7008
      import: app/west.yml
    - name: zmk-trackball-processors
      url: https://github.com/kaievns/zmk-trackball-processors
      revision: 4fb5c8ca4b6cbabf1a7b46db8c5520e975759793
  self:
    path: config
```

## dts/bindings/behaviors/reel,display-state.yaml
```yaml
# SPDX-License-Identifier: MIT

description: |
  Internal ReeL split display snapshot receiver. A press supplies the central's
  highest active layer (param1, 0..3). Param2 is reserved and ignored to remain
  compatible with the earlier central firmware that sent a host BLE profile.
  Define the same device name, reel_dis, on central and peripherals. It matches
  the eight-character name sent by older dongles that used reel_disp.
  This behavior does not need a keymap binding. Releases have no effect.

compatible: "reel,display-state"

include: two_param.yaml
```

## dts/bindings/input_processors/reel,input-probe.yaml
```yaml
description: Diagnostic snapshots before and after trackball input processors
compatible: "reel,input-probe"
include: ip_one_param.yaml
```

## dts/bindings/input_processors/reel,smart-aml.yaml
```yaml
description: ReeL automatic mouse layer for synchronized trackball motion
compatible: "reel,smart-aml"
include: ip_zero_param.yaml
```

## dts/bindings/sensor/reel,active-encoder.yaml
```yaml
description: ReeL two-contact roller with a grounded phase and a probed common
compatible: "reel,active-encoder"
include: sensor-device.yaml
properties:
  sense-gpios:
    type: phandle-array
    required: true
    description: Physical phase A, input with pull-up
  probe-gpios:
    type: phandle-array
    required: true
    description: Physical common C, open-drain low or released; phase B is grounded
```
