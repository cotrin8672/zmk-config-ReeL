## boards/shields/reel/Kconfig.defconfig
```kconfig
if SHIELD_REEL_LEFT || SHIELD_REEL_RIGHT || SHIELD_REEL_DONGLE

config ZMK_SPLIT
    default y

config ZMK_POINTING
    default y

endif

if SHIELD_REEL_DONGLE

config ZMK_KEYBOARD_NAME
    default "ReeL"

config ZMK_SPLIT_ROLE_CENTRAL
    default y

config ZMK_SPLIT_BLE_CENTRAL_PERIPHERALS
    default 2

config BT_MAX_CONN
    default 7

config BT_MAX_PAIRED
    default 7

endif
```

## boards/shields/reel/Kconfig.shield
```kconfig
config SHIELD_REEL_LEFT
    def_bool $(shields_list_contains,reel_left)

config SHIELD_REEL_RIGHT
    def_bool $(shields_list_contains,reel_right)

config SHIELD_REEL_DONGLE
    def_bool $(shields_list_contains,reel_dongle)
```

## config/west.yml
```yaml
manifest:
  projects:
    - name: zmk
      url: https://github.com/zmkfirmware/zmk
      revision: acfd8e5ea76cf23ad1c9b6b99848f97a95224257
      import: app/west.yml
    - name: zmk-component-raytac-dongle
      url: https://github.com/rschenk/zmk-component-raytac-dongle
      revision: 54d4eb91404b2c5552c44803e4f3acc2f653896b
    - name: zmk-pmw3610-driver
      url: https://github.com/badjeff/zmk-pmw3610-driver
      revision: 5c5af40de4d8cdf55dc63c4c5907af1e52da6a95
  self:
    path: config
```
