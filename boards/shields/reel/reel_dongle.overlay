#include "reel.dtsi"
#include <input/processors.dtsi>
#include <dt-bindings/zmk/input_transform.h>

&ball_split { status = "okay"; };

/ {
    kscan: kscan {
        compatible = "zmk,kscan-mock";
        rows = <0>;
        columns = <0>;
        events = <0>;
    };

    ball_listener {
        compatible = "zmk,input-listener";
        device = <&ball_split>;
        // Dominant directions of the RMK calibration: (raw Y, -raw X).
        input-processors = <&zip_xy_transform (INPUT_TRANSFORM_XY_SWAP | INPUT_TRANSFORM_Y_INVERT)>,
                           <&zip_temp_layer 3 5000>;
    };
};
